## subsys/random/Kconfig
```kconfig
# Random configuration options

# Copyright (c) 2017 Intel Corporation
# SPDX-License-Identifier: Apache-2.0

menu "Random Number Generators"

config TEST_RANDOM_GENERATOR
	bool "Non-random number generator"
	depends on !ENTROPY_HAS_DRIVER
	help
	  This option signifies that the kernel's random number APIs are
	  permitted to return values that are not truly random.
	  This capability is provided for testing purposes, when a truly random
	  number generator is not available. The non-random number generator
	  should not be used in a production environment.

choice RNG_GENERATOR_CHOICE
	prompt "Random generator"
	default ENTROPY_DEVICE_RANDOM_GENERATOR
	depends on ENTROPY_HAS_DRIVER || TEST_RANDOM_GENERATOR
	help
	  Platform dependent non-cryptographically secure random number support.

	  If the entropy support of the platform has sufficient performance
	  to support random request then select that. Otherwise, select the
	  XOROSHIRO algorithm

config TIMER_RANDOM_GENERATOR
	bool "System timer clock based number generator"
	depends on TEST_RANDOM_GENERATOR
	help
	  This options enables number generator based on system timer
	  clock. This number generator is not random and used for
	  testing only.

config ENTROPY_DEVICE_RANDOM_GENERATOR
	bool "Use entropy driver to generate random numbers"
	depends on ENTROPY_HAS_DRIVER
	help
	  Enables a random number generator that uses the enabled hardware
	  entropy gathering driver to generate random numbers. Should only be
	  selected if hardware entropy driver is designed to be a random
	  number generator source.

config XOROSHIRO_RANDOM_GENERATOR
	bool "Use Xoroshiro128+ as PRNG"
	depends on ENTROPY_HAS_DRIVER
	help
	  Enables the Xoroshiro128+ pseudo-random number generator, that uses
	  the entropy driver as a seed source.  This is a fast non-cryptographically
	  secure random number generator.

	  It is so named because it uses 128 bits of state.

endchoice # RNG_GENERATOR_CHOICE

#
# This configurations enables Cryptographically Secure Pseudo-Random Number
# Generator APIs. These configurations are dependent on an entropy
# source.
#
config CSPRNG_ENABLED
#	bool "Cryptographically Secure PRNG functions enabled"
	bool
	default y
	depends on ENTROPY_HAS_DRIVER

choice CSPRNG_GENERATOR_CHOICE
	prompt "Cryptographically Secure PRNG"
	default HARDWARE_DEVICE_CSPRNG_GENERATOR
	help
	  Platform dependent Cryptographically Secure Pseudo-Random Number Generator
	  support.

config HARDWARE_DEVICE_CSPRNG_GENERATOR
	bool "Use hardware random driver for CSPRNG"
	depends on ENTROPY_HAS_DRIVER
	depends on ENTROPY_SUPPORT_CSPRNG
	help
	  Enables a Cryptographically Secure PRNG implemented by the entropy driver.
	  The CSPRNG must be seeded by an entropy source. Examples of CSPRNGs
	  qualified as being cryptographically secure is CTR_DRBG and HMAC_DRBG.

config CTR_DRBG_CSPRNG_GENERATOR
	bool "Use CTR_DRBG CSPRNG"
	depends on MBEDTLS || TINYCRYPT
	depends on ENTROPY_HAS_DRIVER
	select TINYCRYPT_CTR_PRNG if TINYCRYPT
	select TINYCRYPT_AES if TINYCRYPT
	help
	  Enables CTR_DRBG implemented in the random subsystem. This CSPRNG
	  shall use the entropy API for seeding. CTR_DRBG is qualified as being
	  a Cryptographically Secure PRNG.

endchoice # CSPRNG_GENERATOR_CHOICE

config CTR_DRBG_CSPRNG_PERSONALIZATION
	string "CTR_DRBG Personalization string"
	default "zephyr CTR_DRBG seed"
	depends on CTR_DRBG_CSPRNG_GENERATOR
	help
	  Personalization data can be provided in addition to the entropy
	  source to make the initialization of the CTR_DRBG as unique as
	  possible.

endmenu
```
